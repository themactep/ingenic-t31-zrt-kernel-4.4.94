## drivers/video/ingenic_sensors/Kconfig
```kconfig
menuconfig INGENIC_SENSORS
	tristate "Ingenic Sensor modules for the TX-ISP"
	default m
	help
	  Support for Ingenic Sensors.

config INGENIC_SENSOR_GC2053
	tristate "Ingenic Sensor module for GC2053"
	depends on INGENIC_SENSORS
	default m
	help
	  Module for gc2053.
```

## drivers/video/ingenic_sinfo/Kconfig
```kconfig
config INGENIC_SINFO
	tristate "Ingenic Sensor Info"
	default y
	help
	  Support for Ingenic Sensor Info (sinfo).
```

## kernel-4.4.94/arch/mips/xburst/soc-t31/Kconfig.DT
```kconfig
config DT_T31_SWAN
	bool "t31 swan"

config DT_T31_PERSONALCAM
	bool "t31x based Wyze Pan V3 clone"
```

## kernel-4.4.94/arch/mips/xburst2/Kconfig
```kconfig
if MACH_XBURST2

menu "SOC Type Selection"
	depends on MACH_XBURST2


choice
	prompt "SOC types"
	depends on MACH_XBURST2
	default SOC_T40


config SOC_T40
	bool "t40"
	select IRQ_INGENIC_CPU
	select CLK_T40
	select INGENIC_INTC_CHIP
	select PINCTRL
	select PINCTRL_INGENIC
	select BUILTIN_DTB
	select CLKSRC_OF
	select CLKDEV_LOOKUP
	select CLKSRC_INGENIC_CORE_OST


config SOC_X2000_V12
	bool "x2000-v12"
	select IRQ_INGENIC_CPU
	select CLK_X2000_V12
	select INGENIC_INTC_CHIP
	select PINCTRL
	select PINCTRL_INGENIC
	select BUILTIN_DTB
	select CLKSRC_OF
	select CLKDEV_LOOKUP
	select CLKSRC_INGENIC_CORE_OST

endchoice

choice
	prompt "device tree select"
	default DT_NONE
config DT_NONE

if SOC_T40
source "arch/mips/xburst2/soc-t40/Kconfig.DT"
endif

if SOC_X2000_V12
source "arch/mips/xburst2/soc-x2000-v12/Kconfig.DT"
endif

endchoice

config RAW_BOOT
	bool "Raw Boot Kernel"
	select BOOT_RAW
	default n

config EXTAL_CLOCK
	depends on MACH_XBURST2
	int "extal clock in MHz"
	default 24

config FPGA_TEST
	depends on MACH_XBURST2
	bool "FPGA_TEST"
	default n

endmenu

endif
```

## kernel-4.4.94/drivers/video/ingenic_isp/Kconfig
```kconfig
config INGENIC_ISP
	tristate "ISP 3.x kernel module port"
	default m
	help
	  Enables the kernel 3.x ISP module port.
```

## kernel-4.4.94/sound/mips/ingenic-oss3/Kconfig
```kconfig
if SND_MIPS

config SND_INGENIC_OSS3_AUDIO
	tristate "Ingenic OSS3 Audio"
	depends on SOC_T31
	select SND_PCM
	help
			Sound support for the Ingenic socs that support OSS3.
endif	# SND_MIPS
```
